#include "qmath.h"
#include "device.h"   /* 提供 PI 宏 */
#include <math.h>
#include <float.h>
#include <stdio.h>

#ifndef M_PI
#define M_PI 3.14159265358979323846f
#endif
#define TWO_PI      (2.0f * PI)
#define THREE_PI    (3.0f * PI)
#define PI_OVER_TWO (PI * 0.5f)


#ifndef NAN
#define NAN (0.0f / 0.0f)
#endif

#ifndef isfinite
#define isfinite(x) ((x) == (x) && (x) != (x) * 2.0f)
#endif

// === 需要运行脚本生成的查找表 ===
// 0到π/2的正弦值表 (1000个点)
static const float sin_val[1000] = { 
    0.00000000f,    0.00157237f,    0.00314473f,    0.00471709f,    0.00628943f,
    0.00786176f,    0.00943407f,    0.01100636f,    0.01257862f,    0.01415085f,
    0.01572304f,    0.01729519f,    0.01886730f,    0.02043937f,    0.02201138f,
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    0.99998022f,    0.99998887f,    0.99999506f,    0.99999876f,    1.00000000f,
    // 运行 generate_sin_table.py 生成的数据将放在这里
};

// 0到1的反正弦值表 (1000个点)
static const float asin_val[1000] = { 
    0.00000000f,    0.00100100f,    0.00200200f,    0.00300301f,    0.00400401f,
    0.00500503f,    0.00600604f,    0.00700706f,    0.00800809f,    0.00900913f,
    0.01001018f,    0.01101123f,    0.01201230f,    0.01301338f,    0.01401447f,
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    1.48127897f,    1.49327849f,    1.50750857f,    1.52604886f,    1.57079633f,
    // 运行 generate_asin_table.py 生成的数据将放在这里
};

// 0到1的反正切值表 (1000个点)
static const float atan_val[1000] = { 
    0.00000000f,    0.00100100f,    0.00200200f,    0.00300299f,    0.00400398f,
    0.00500496f,    0.00600593f,    0.00700689f,    0.00800784f,    0.00900877f,
    0.01000968f,    0.01101057f,    0.01201143f,    0.01301228f,    0.01401310f,
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    0.78339215f,    0.78389441f,    0.78439616f,    0.78489741f,    0.78539816f,
    // 运行 generate_atan_table.py 生成的数据将放在这里
};
// === 查找表结束 ===

// 计算弧度x的正弦值
//float qsin_rad(float x) {
//    // 规范化到[0, 2π)
//    x = fmodf(x, 2.0f * (float)M_PI);
//    if (x < 0) x += 2.0f * (float)M_PI;

//    float sign = 1.0f;

//    // 象限处理（缩小弧度）
//    if (x > 3.0f * (float)M_PI / 2.0f) {
//        x = 2.0f * (float)M_PI - x;
//        sign = -1.0f;
//    }
//    else if (x > (float)M_PI) {
//        x = x - (float)M_PI;
//        sign = -1.0f;
//    }
//    else if (x > (float)M_PI / 2.0f) {
//        x = (float)M_PI - x;
//    }

//    // 计算索引（四舍五入）
//    float index_f = x * 999.0f / ((float)M_PI / 2.0f);
//    int idx = (int)(index_f + 0.5f);
//    if (idx < 0) idx = 0;
//    if (idx >= 1000) idx = 999;
//    
//    return sign * sin_val[idx];
//}

float qsin_rad(float x) {
    // 规范化到[0, 2π)
    x = fmodf(x, TWO_PI);
    if (x < 0) x += TWO_PI;

    float sign = 1.0f;

    // 象限处理（缩小弧度）
    if (x > THREE_PI / 2.0f) {
        x = TWO_PI - x;
        sign = -1.0f;
    }
    else if (x > (float)M_PI) {
        x = x - (float)M_PI;
        sign = -1.0f;
    }
    else if (x > PI_OVER_TWO) {
        x = (float)M_PI - x;
    }

    // 计算索引（四舍五入）
    float index_f = x *636.0f;
    int idx = (int)(index_f + 0.5f);
    if (idx < 0) idx = 0;
    if (idx >= 1000) idx = 999;

    return sign * sin_val[idx];
}


// 余弦函数（弧度参数）
float qcos_rad(float x) {
    return qsin_rad(x + PI_OVER_TWO);
}

// 正切函数（弧度参数）
float qtan_rad(float x) {

    // 正常的计算流程
    float s = qsin_rad(x);
    float c = qcos_rad(x);

    // 避免除零错误
    if (fabsf(c) < 1e-1f) {
        return tanf(x);
    }

    return s / c;
}

// 反正弦函数
float qasin_rad(float x) {
    // 钳制输入值
    if (x < -1.0f) x = -1.0f;
    if (x > 1.0f) x = 1.0f;

    float sign = 1.0f;
    float abs_x = x;

    // 处理负值
    if (x < 0) {
        sign = -1.0f;
        abs_x = -x;
    }

    // 计算索引（四舍五入）
    float index_f = abs_x * 999.0f;
    int idx = (int)(index_f + 0.5f);
    if (idx < 0) idx = 0;
    if (idx >= 1000) idx = 999;

    return sign * asin_val[idx];
}

// 反余弦函数
float qacos_rad(float x) {
    return (float)PI_OVER_TWO - qasin_rad(x);
}

// 反正切函数
float qatan_rad(float x) {
    float sign = 1.0f;
    float abs_x = x;

    // 处理负值
    if (x < 0) {
        sign = -1.0f;
        abs_x = -x;
    }

    float result;

    if (abs_x <= 1.0f) {
        // 对于 |x| <= 1，直接查表
        float index_f = abs_x * 999.0f;
        int idx = (int)(index_f + 0.5f);
        if (idx < 0) idx = 0;
        if (idx >= 1000) idx = 999;
        result = atan_val[idx];
    }
    else {
        // 对于 |x| > 1，使用恒等式 atan(x) = π/2 - atan(1/x)
        float reciprocal = 1.0f / abs_x;
        float index_f = reciprocal * 999.0f;
        int idx = (int)(index_f + 0.5f);
        if (idx < 0) idx = 0;
        if (idx >= 1000) idx = 999;

        float atan_reciprocal = atan_val[idx];
        result = (float)PI_OVER_TWO - atan_reciprocal;
    }

    return sign * result;
}

// 反正切函数（两个参数版本）
float qatan2_rad(float y, float x) {
    if (x > 0) {
        // 第一、四象限
        return qatan_rad(y / x);
    }
    else if (x < 0) {
        if (y >= 0) {
            // 第二象限
            return qatan_rad(y / x) + (float)M_PI;
        }
        else {
            // 第三象限
            return qatan_rad(y / x) - (float)M_PI;
        }
    }
    else {
        if (y > 0) {
            return (float)PI_OVER_TWO;
        }
        else if (y < 0) {
            return -(float)PI_OVER_TWO;
        }
        else {
            return 0.0f;
        }
    }
}


// void QMATH_test(){
//     char jkjk[26] = {0};
//     int bf, af;
//     while(1){
//
//         bf = get_current_time();
// //    USART3_SendChar(',');
//
//     for (uint16_t i = 0; i < 10000; i++){
//
//         // float a = qatan_rad(19.8988459);
//         float a = qatan2_rad(2.3532532, 5.2424);
//
//     }
//
//     USART3_SendString(uint64_to_string(get_current_time() - bf, jkjk));
//     USART3_SendChar('\n');
//
//     }
//
//
//
// }

